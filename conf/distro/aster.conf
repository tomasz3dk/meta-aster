## conf/distro/aster.conf
```bitbake
require conf/distro/poky.conf      
DISTRO = "aster"      
DISTRO_NAME = "AsterTom Distro"      
DISTRO_VERSION = "1.0"      
DISTRO_CODENAME = "aster"      
DISTRO_FEATURES += "usbhost systemd ipv6 keyboard touchscreen"
DISTRO_FEATURES_BACKFILL_CONSIDERED += "sysvinit"
VIRTUAL-RUNTIME_login_manager = "shadow-base"
VIRTUAL-RUNTIME_init_manager = "systemd"
VIRTUAL-RUNTIME_initscripts = "systemd-compat-units"
SDK_VENDOR = "-astersdk"
SDK_VERSION := "${@'${DISTRO_VERSION}'.replace('snapshot-${DATE}','snapshot')}"      
MAINTAINER = "drazektomasz@gmail.com"      
INHERIT += "buildhistory"      
BUILDHISTORY_COMMIT = "1"
TARGET_VENDOR = "-aster"
SDKPATH = "/home/jenkins/AsterTom/sdk_${MACHINE}"
```

## conf/layer.conf
```bitbake
# We have a conf and classes directory, add to BBPATH
BBPATH .= ":${LAYERDIR}:${LAYERDIR}/common"

# We have recipes-* directories, add to BBFILES
BBFILES += " \
	    ${LAYERDIR}/recipes-*/*/*.bb \
	    ${LAYERDIR}/recipes-*/*/*.bbappend \
	    ${LAYERDIR}/recipes-*/*.bb \
		${LAYERDIR}/recipes-*/*.bbappend \
"
BBFILES_DYNAMIC += " \
	raspberrypi:${LAYERDIR}/dynamic-layers/meta-raspberrypi/recipes-*/*/*.bb \
	raspberrypi:${LAYERDIR}/dynamic-layers/meta-raspberrypi/recipes-*/*/*.bbappend \
	raspberrypi:${LAYERDIR}/dynamic-layers/meta-raspberrypi/recipes-*/*.bb \
	raspberrypi:${LAYERDIR}/dynamic-layers/meta-raspberrypi/recipes-*/*.bbappend \
"                                                                                                                                  
BBFILE_COLLECTIONS += ""
BBFILE_PRIORITY_aster = "5"

# Additional license directories.
LICENSE_PATH += "${LAYERDIR}/licenses"

LAYERDEPENDS_aster = ""
LAYERRECOMMENDS_aster = ""

LAYERVERSION_aster = "1"
LAYERSERIES_COMPAT_aster = "dunfell"


require ${LAYERDIR}/conf/include/maintainers.inc
```
